## BLE/agBLE/Kconfig
```kconfig
menu "AG BLE configuration"

config AGBLE_CLIENT_ENABLED
    bool "Enable AG BLE central/client"
    depends on BT_ENABLED && BT_NIMBLE_ENABLED
    depends on BT_NIMBLE_ROLE_CENTRAL && BT_NIMBLE_ROLE_OBSERVER && BT_NIMBLE_GATT_CLIENT
    depends on BT_NIMBLE_GATT_SERVER
    default y
    help
        ESP-IDF 5.4.2 NimBLE teardown also requires SDK GATT server support,
        even when the AG BLE server implementation is disabled.

config AGBLE_SERVER_ENABLED
    bool "Enable AG BLE peripheral/server"
    depends on BT_ENABLED && BT_NIMBLE_ENABLED
    depends on BT_NIMBLE_ROLE_PERIPHERAL && BT_NIMBLE_ROLE_BROADCASTER && BT_NIMBLE_GATT_SERVER
    default y

config AGBLE_STOP_TIMEOUT_MS
    int "Host task exit timeout (milliseconds)"
    depends on AGBLE_CLIENT_ENABLED || AGBLE_SERVER_ENABLED
    range 100 60000
    default 5000

endmenu
```

## examples/ble/sdkconfig.defaults
```kconfig
CONFIG_BT_ENABLED=y
CONFIG_BT_BLUEDROID_ENABLED=n
CONFIG_BT_NIMBLE_ENABLED=y
CONFIG_BT_NIMBLE_ROLE_CENTRAL=n
CONFIG_BT_NIMBLE_ROLE_OBSERVER=n
CONFIG_BT_NIMBLE_GATT_CLIENT=n
CONFIG_BT_NIMBLE_ROLE_PERIPHERAL=y
CONFIG_BT_NIMBLE_ROLE_BROADCASTER=y
CONFIG_BT_NIMBLE_GATT_SERVER=y
CONFIG_BT_NIMBLE_MAX_CONNECTIONS=1
CONFIG_AGBLE_CLIENT_ENABLED=n
CONFIG_AGBLE_SERVER_ENABLED=y
```

## wifi/agwifi/Kconfig
```kconfig
menu "AG Wi-Fi configuration"

config ESP_WIFI_SSID
    string "Wi-Fi SSID"
    default ""

config ESP_WIFI_PASSWORD
    string "Wi-Fi password"
    default ""

config ESP_MAXIMUM_RETRY
    int "Maximum reconnection attempts"
    range 0 100
    default 5

config AGWIFI_CONNECT_TIMEOUT_MS
    int "Connection timeout (milliseconds)"
    range 1000 3600000
    default 30000

choice ESP_WIFI_SAE_MODE
    prompt "WPA3 SAE mode"
    default ESP_WPA3_SAE_PWE_BOTH

config ESP_WPA3_SAE_PWE_HUNT_AND_PECK
    bool "Hunt and Peck"
config ESP_WPA3_SAE_PWE_HASH_TO_ELEMENT
    bool "Hash to Element"
config ESP_WPA3_SAE_PWE_BOTH
    bool "Both"
endchoice

config ESP_WIFI_PW_ID
    string "SAE H2E password identifier"
    depends on ESP_WPA3_SAE_PWE_HASH_TO_ELEMENT || ESP_WPA3_SAE_PWE_BOTH
    default ""

choice ESP_WIFI_SCAN_AUTH_MODE_THRESHOLD
    prompt "Minimum accepted authentication mode"
    default ESP_WIFI_AUTH_WPA2_PSK

config ESP_WIFI_AUTH_OPEN
    bool "Open"
config ESP_WIFI_AUTH_WEP
    bool "WEP"
config ESP_WIFI_AUTH_WPA_PSK
    bool "WPA PSK"
config ESP_WIFI_AUTH_WPA2_PSK
    bool "WPA2 PSK"
config ESP_WIFI_AUTH_WPA_WPA2_PSK
    bool "WPA/WPA2 PSK"
config ESP_WIFI_AUTH_WPA3_PSK
    bool "WPA3 PSK"
config ESP_WIFI_AUTH_WPA2_WPA3_PSK
    bool "WPA2/WPA3 PSK"
config ESP_WIFI_AUTH_WAPI_PSK
    bool "WAPI PSK"
endchoice

endmenu
```
